## configs/apissys_av108_defconfig
```kconfig
BR2_arm=y
BR2_cortex_a9=y
BR2_TOOLCHAIN_EXTERNAL=y
BR2_TOOLCHAIN_EXTERNAL_CODESOURCERY_ARM201203=y
BR2_TOOLCHAIN_EXTERNAL_GDB_SERVER_COPY=y
BR2_TARGET_OPTIMIZATION="-pipe -march=armv7-a -mcpu=cortex-a9 -mfpu=neon-fp16 -mfloat-abi=softfp -ftree-vectorize"
BR2_TARGET_GENERIC_HOSTNAME="av108"
BR2_TARGET_GENERIC_ISSUE="Welcome to ApisSys AV108 Linux"
BR2_TARGET_GENERIC_PASSWD_SHA512=y
BR2_ROOTFS_DEVICE_CREATION_DYNAMIC_MDEV=y
BR2_ROOTFS_DEVICE_TABLE="board/apissys/av108/device_table.txt"
BR2_TARGET_GENERIC_ROOT_PASSWD="root"
BR2_TARGET_GENERIC_GETTY_PORT="ttyPS1"
BR2_ROOTFS_OVERLAY="board/apissys/av108/fs_overlay"
BR2_ROOTFS_POST_BUILD_SCRIPT="board/apissys/av108/post_build.sh"
BR2_ROOTFS_POST_IMAGE_SCRIPT="board/apissys/av108/post_image_creation.sh"
BR2_PACKAGE_BUSYBOX_CONFIG="board/apissys/av108/busybox-1.22.x.config"
BR2_PACKAGE_BZIP2=y
BR2_PACKAGE_XZ=y
BR2_PACKAGE_STRACE=y
BR2_PACKAGE_CIFS_UTILS=y
BR2_PACKAGE_CRAMFS=y
BR2_PACKAGE_E2FSPROGS=y
# BR2_PACKAGE_E2FSPROGS_E2FREEFRAG is not set
# BR2_PACKAGE_E2FSPROGS_E2FSCK is not set
# BR2_PACKAGE_E2FSPROGS_E2UNDO is not set
# BR2_PACKAGE_E2FSPROGS_FILEFRAG is not set
# BR2_PACKAGE_E2FSPROGS_TUNE2FS is not set
BR2_PACKAGE_NFS_UTILS=y
BR2_PACKAGE_NTFS_3G=y
BR2_PACKAGE_LZO=y
BR2_PACKAGE_OPENSSL=y
BR2_PACKAGE_LIBFUSE=y
BR2_PACKAGE_LIBCURL=y
BR2_PACKAGE_LIBELF=y
BR2_PACKAGE_LIBGLIB2=y
BR2_PACKAGE_READLINE=y
BR2_PACKAGE_DROPBEAR=y
BR2_PACKAGE_DROPBEAR_DISABLE_REVERSEDNS=y
BR2_PACKAGE_DROPBEAR_WTMP=y
BR2_PACKAGE_DROPBEAR_LASTLOG=y
BR2_PACKAGE_ETHTOOL=y
BR2_PACKAGE_ACL=y
BR2_PACKAGE_NANO=y
BR2_TARGET_ROOTFS_CPIO=y
BR2_TARGET_ROOTFS_CPIO_GZIP=y
BR2_TARGET_ROOTFS_EXT2=y
BR2_TARGET_ROOTFS_EXT2_GZIP=y
# BR2_TARGET_ROOTFS_TAR is not set
```
